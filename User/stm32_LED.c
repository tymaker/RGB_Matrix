/******************** (C) COPYRIGHT 2011  ********************
 * 文件名  ：
 * 描述    ：
 *                   
 * 实验平台：
 * 库版本  ：
 *
 * 作者    ：
 * 博客    ：
**********************************************************************************/
#include "stm32_LED.H"


u32 Red_Write  [MAX_light/32] = {0,0};    //缓存
u32 Green_Write[MAX_light/32] = {0,0};
u32 Blue_Write [MAX_light/32] = {0,0};
//开机动画缓存
u8 String_R[]={
//0x00,0x07,0xE0,0x00,0x80,0x07,0xFF,0xFE,0x00,0x1F,0xFC,0x00,0xC0,0x0F,0xFF,0xFE,
//0x00,0x7F,0xFF,0x00,0xC0,0x0F,0xFF,0xFE,0x01,0xC0,0x7F,0x80,0xC0,0x1F,0xFF,0xFC,
//0x03,0x00,0x1F,0xE0,0x40,0x1F,0xFF,0xFC,0x06,0x00,0x1F,0xF0,0x60,0x3F,0xFF,0xFC,
//0x0C,0x00,0x0F,0xF0,0x60,0x3F,0xCF,0xF8,0x18,0x0F,0x0F,0xF8,0x30,0x3F,0xCF,0xF8,
//0x18,0x0F,0x0F,0xFC,0x10,0x1F,0xFF,0xF0,0x30,0x0F,0x0F,0xFC,0x18,0x1F,0xFF,0xE0,
//0x30,0x06,0x0F,0xFE,0x0C,0x1F,0xFF,0xC0,0x20,0x00,0x0F,0xFE,0x07,0x0F,0xFF,0x80,
//0x60,0x00,0x0F,0xFF,0x01,0xC7,0xFF,0x00,0x60,0x00,0x1F,0xFF,0x00,0xF9,0xFC,0x00,
//0x60,0x00,0x3F,0xFF,0x00,0x3F,0xF0,0x00,0x40,0x00,0xFF,0xFF,0x00,0x0F,0xE0,0x00,
0x00,0x00,0x00,0x00,0x19,0x6C,0x60,0x10,0x00,0x00,0x00,0x00,0x1A,0xC8,0x60,0xC0,
0x00,0x00,0x00,0x00,0x0C,0xD8,0x00,0xE0,0x00,0x00,0x00,0x00,0x07,0x90,0x00,0x00,
0x00,0x00,0x00,0x00,0x01,0x70,0x21,0x00,0x00,0x00,0x00,0x00,0x00,0x38,0x2D,0x00,
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0x01,0xD8,0xDD,0xF0,0x00,0x00,0x00,0x00,0x03,0xED,0x80,0x38,0x00,0x00,0x00,0x00,

};
u8 String_G[]={
0x00,0x00,0x00,0x00,0x19,0x6C,0x60,0x10,0x00,0x00,0x00,0x00,0x1A,0xC8,0x60,0xC0,
0x00,0x00,0x00,0x00,0x0C,0xD8,0x00,0xE0,0x00,0x00,0x00,0x00,0x07,0x90,0x00,0x00,
0x00,0x00,0x00,0x00,0x01,0x70,0x21,0x00,0x00,0x00,0x00,0x00,0x00,0x38,0x2D,0x00,
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0x01,0xD8,0xDD,0xF0,0x00,0x00,0x00,0x00,0x03,0xED,0x80,0x38,0x00,0x00,0x00,0x00,

};
u8 String_B[]={
0x00,0x00,0x00,0x00,0x19,0x6C,0x60,0x10,0x00,0x00,0x00,0x00,0x1A,0xC8,0x60,0xC0,
0x00,0x00,0x00,0x00,0x0C,0xD8,0x00,0xE0,0x00,0x00,0x00,0x00,0x07,0x90,0x00,0x00,
0x00,0x00,0x00,0x00,0x01,0x70,0x21,0x00,0x00,0x00,0x00,0x00,0x00,0x38,0x2D,0x00,
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0x01,0xD8,0xDD,0xF0,0x00,0x00,0x00,0x00,0x03,0xED,0x80,0x38,0x00,0x00,0x00,0x00,

};

u8 String_number[]={
/*--  文字:  0  --*/
/*--  宋体12;  此字体下对应的点阵为：宽x高=8x16   --*/
0x00,0x00,0x00,0x18,0x24,0x42,0x42,0x42,0x42,0x42,0x42,0x42,0x24,0x18,0x00,0x00,

/*--  文字:  1  --*/
/*--  宋体12;  此字体下对应的点阵为：宽x高=8x16   --*/
0x00,0x00,0x00,0x08,0x38,0x08,0x08,0x08,0x08,0x08,0x08,0x08,0x08,0x3E,0x00,0x00,

/*--  文字:  2  --*/
/*--  宋体12;  此字体下对应的点阵为：宽x高=8x16   --*/
0x00,0x00,0x00,0x3C,0x42,0x42,0x42,0x02,0x04,0x08,0x10,0x20,0x42,0x7E,0x00,0x00,

/*--  文字:  3  --*/
/*--  宋体12;  此字体下对应的点阵为：宽x高=8x16   --*/
0x00,0x00,0x00,0x3C,0x42,0x42,0x02,0x04,0x18,0x04,0x02,0x42,0x42,0x3C,0x00,0x00,

/*--  文字:  4  --*/
/*--  宋体12;  此字体下对应的点阵为：宽x高=8x16   --*/
0x00,0x00,0x00,0x04,0x0C,0x0C,0x14,0x24,0x24,0x44,0x7F,0x04,0x04,0x1F,0x00,0x00,

/*--  文字:  5  --*/
/*--  宋体12;  此字体下对应的点阵为：宽x高=8x16   --*/
0x00,0x00,0x00,0x7E,0x40,0x40,0x40,0x78,0x44,0x02,0x02,0x42,0x44,0x38,0x00,0x00,

/*--  文字:  6  --*/
/*--  宋体12;  此字体下对应的点阵为：宽x高=8x16   --*/
0x00,0x00,0x00,0x18,0x24,0x40,0x40,0x5C,0x62,0x42,0x42,0x42,0x22,0x1C,0x00,0x00,

/*--  文字:  7  --*/
/*--  宋体12;  此字体下对应的点阵为：宽x高=8x16   --*/
0x00,0x00,0x00,0x7E,0x42,0x04,0x04,0x08,0x08,0x10,0x10,0x10,0x10,0x10,0x00,0x00,

/*--  文字:  8  --*/
/*--  宋体12;  此字体下对应的点阵为：宽x高=8x16   --*/
0x00,0x00,0x00,0x3C,0x42,0x42,0x42,0x24,0x18,0x24,0x42,0x42,0x42,0x3C,0x00,0x00,

/*--  文字:  9  --*/
/*--  宋体12;  此字体下对应的点阵为：宽x高=8x16   --*/
0x00,0x00,0x00,0x38,0x44,0x42,0x42,0x42,0x46,0x3A,0x02,0x02,0x24,0x18,0x00,0x00,
};

//u8 String_R[MAX_light*2];
//u8 String_G[MAX_light*2];
//u8 String_B[MAX_light*2];
u8 String_DisCache_R[MAX_light*2]={0};
u8 String_DisCache_G[MAX_light*2]={0};
u8 String_DisCache_B[MAX_light*2]={0};
//STR_num=(countof(String)/32);

/*
写入一行数据，
*/
/***********           红色 绿色 蓝色 字节数据  颜色            **************/
void RGB_Write_Byte(u32 RED,u32 GREEN,u32 BLUE,u8 Page)
{
    u8 i;        //初始化
	  u32 r,g,b;    //三原色缓存
	  r=RED;                  //赋值
	  g=GREEN;
	  b=BLUE;
	  SCK_L;                  //拉低时钟
	  if(Page)  //Page 为1时，写入上半部分
	      for(i=0;i<32;i++)
			  {
					 ((r & 0x80000000) ==0x80000000)? R1_H:R1_L;
					 ((g & 0x80000000) ==0x80000000)? G1_H:G1_L;
					 ((b & 0x80000000) ==0x80000000)? B1_H:B1_L;
						r=r<<1;
						g=g<<1;
						b=b<<1;
						SCK_H;
						SCK_L;
        }
		 else    //写入下半部分
				for(i=0;i<32;i++)
				{
					 ((r & 0x80000000) ==0x80000000)? R2_H:R2_L;
					 ((g & 0x80000000) ==0x80000000)? G2_H:G2_L;
					 ((b & 0x80000000) ==0x80000000)? B2_H:B2_L;
						r=r<<1;
						g=g<<1;
						b=b<<1;
						SCK_H;
						SCK_L;
				}
}
void RGB_Clear(u8 Page)
{
    u8 i;        //初始化
	  OE_H;
	  LE_L;        //设置锁存信号为低
	  SCK_L;       //拉低时钟
	  if(Page)  //Page 为1时，写入上半部分
	      for(i=0;i<64;i++)
			  {
					  R1_L;
					  G1_L;
					  B1_L;
						SCK_H;
						SCK_L;
        }
		 else    //写入下半部分
				for(i=0;i<64;i++)
				{
          R2_L;
					G2_L;
					B2_L;
					SCK_H;
					SCK_L;
				}
		LE_H;
		LE_L;
}

void RGB_Write(unsigned char Line)  //写入数据
{
	  u8 j=0,Page;
	  u16 delay=5000;
	  if(Line<9)
		    Page=1;
		else
			  Page=0;
	  #if (MAX_light==32)   //写入一行数据
		    RGB_Write_Byte(Red_Write[j],Green_Write[j],Blue_Write[j],Page);
	  #else
			for(j=0;j<2;j++)
			{
					RGB_Write_Byte(Red_Write[j],Green_Write[j],Blue_Write[j],Page);
			}
	  #endif
    OE_H;
		LE_H;        //数据写入锁存
		LE_L;
		switch (Line)
		{
				case 1:A_L;B_L;C_L;break;
				case 5:A_L;B_L;C_H;break;
				case 3:A_L;B_H;C_L;break;
				case 7:A_L;B_H;C_H;break;
				case 2:A_H;B_L;C_L;break;
				case 6:A_H;B_L;C_H;break;
				case 4:A_H;B_H;C_L;break;
				case 8:A_H;B_H;C_H;break;
				case 9:A_L;B_L;C_L;break;
				case 13:A_L;B_L;C_H;break;
				case 11:A_L;B_H;C_L;break;
				case 15:A_L;B_H;C_H;break;
				case 10:A_H;B_L;C_L;break;
				case 14:A_H;B_L;C_H;break;
				case 12:A_H;B_H;C_L;break;
				case 16:A_H;B_H;C_H;break;
				default:OE_H;//A=1;D=1;C=1;
		}
		OE_L;
	  while(delay)
		    delay--;
		OE_H;
}

void display(void)
{
		u8 i;
	  u32 red,red1,green,green1,blue,blue1;
		for(i=1;i<17;i++)
		{
			red=0;
			red = red | String_R[((i-1)*8)+0];
			red =red <<8;
			red = red | String_R[((i-1)*8)+1];
			red =red<<8;
			red = red | String_R[((i-1)*8)+2];
			red =red<<8;
			red = red | String_R[((i-1)*8)+3];
			red1=0;
			red1 = red1 | String_R[((i-1)*8)+4];
			red1 =red1<<8;
			red1 = red1 | String_R[((i-1)*8)+5];
			red1 =red1<<8;
			red1 = red1 | String_R[((i-1)*8)+6];
			red1 =red1<<8;
			red1 = red1 | String_R[((i-1)*8)+7];

			Red_Write[0]=red;
			Red_Write[1]=red1;
/**********************************/
			green=0;
			green = green | String_G[((i-1)*8)+0];
			green =green <<8;
			green = green | String_G[((i-1)*8)+1];
			green =green<<8;
			green = green | String_G[((i-1)*8)+2];
			green =green<<8;
			green = green | String_G[((i-1)*8)+3];
			green1=0;
			green1 = green1 | String_G[((i-1)*8)+4];
			green1 =green1<<8;
			green1 = green1 | String_G[((i-1)*8)+5];
			green1 =green1<<8;
			green1 = green1 | String_G[((i-1)*8)+6];
			green1 =green1<<8;
			green1 = green1 | String_G[((i-1)*8)+7];
			Green_Write[0]=green;
			Green_Write[1]=green1;
/************************************/
			blue=0;
			blue = blue | String_B[((i-1)*8)+0];
			blue =blue <<8;
			blue = blue | String_B[((i-1)*8)+1];
			blue =blue<<8;
			blue = blue | String_B[((i-1)*8)+2];
			blue =blue<<8;
			blue = blue | String_B[((i-1)*8)+3];
			blue1=0;
			blue1 = blue1 | String_B[((i-1)*8)+4];
			blue1 =blue1<<8;
			blue1 = blue1 | String_B[((i-1)*8)+5];
			blue1 =blue1<<8;
			blue1 = blue1 | String_B[((i-1)*8)+6];
			blue1 =blue1<<8;
			blue1 = blue1 | String_B[((i-1)*8)+7];
			Blue_Write[0]=blue;
			Blue_Write[1]=blue1;

			RGB_Write(i);  //写入一行数据
//			OE_H;
		}
}

void Display_num(u16 Num1,u16 Num2,u16 Num3,u16 Num4)
{
    u8 i;
	  u32 red,red1;
	  for(i=0;i<16;i++)
	 {
       red=0;
		   red = red | String_number[(Num1%100/10)*16+i];
		   red = red <<8;
		   red = red | String_number[(Num1%10)*16+i];
		   red = red <<8;
		   red = red | String_number[(Num2%100/10)*16+i];
		   red = red <<8;
		   red = red | String_number[(Num2%10)*16+i];
       red1=0;
		   red1 = red1 | String_number[(Num3%100/10)*16+i];
		   red1 = red1 <<8;
		   red1 = red1 | String_number[(Num3%10)*16+i];
		   red1 = red1 <<8;
		   red1 = red1 | String_number[(Num4%100/10)*16+i];
		   red1 = red1 <<8;
		   red1 = red1 | String_number[(Num4%10)*16+i];
			 Red_Write[0]=red;
			 Red_Write[1]=red1; 
			 RGB_Write(i);

   }
}

void display_HZ(void)
{
		u8 i;
	  u32 red,red1,green,green1,blue,blue1;
	  red=red1=green=green1=blue=blue1=0;
		for(i=0;i<16;i++)
		{
			red=0;
			red = red | String_DisCache_R[((0*32)+i*2)];    //正好下标0 1
			red =red <<8;
			red = red | String_DisCache_R[(0*32)+(i*2)+1];    //正好下标 2 3
			red =red<<8;
			red = red | String_DisCache_R[(0*32)+32+(i*2)+0];   //第二个汉字是从第下标32开始,所以32+0 1
			red =red<<8;
			red = red | String_DisCache_R[(0*32)+32+(i*2)+1];   //  2  3
      red1=0;
			red1 = red1 | String_DisCache_R[(0*32)+2*32+(i*2)+0];  //第三个汉字  2*32 0 1
			red1 =red1<<8;
			red1 = red1 | String_DisCache_R[(0*32)+2*32+(i*2)+1];  //
			red1 =red1<<8;
			red1 = red1 | String_DisCache_R[(0*32)+3*32+(i*2)+0];   //第四个汉字  3*32  0  1
			red1 =red1<<8;
			red1 = red1 | String_DisCache_R[(0*32)+3*32+(i*2)+1];
			
			Red_Write[0]=red;
			Red_Write[1]=red1; 
/**********************************/
      green=0;
			green = green | String_DisCache_G[(i*2)];    //正好下标0 1
			green = green <<8;
			green = green | String_DisCache_G[(i*2)+1];    //正好下标 2 3
			green = green<<8;
			green = green | String_DisCache_G[32+(i*2)+0];   //第二个汉字是从第下标32开始,所以32+0 1
			green = green<<8;
			green = green | String_DisCache_G[32+(i*2)+1];   //  2  3
      green1=0;
			green1 = green1 | String_DisCache_G[2*32+(i*2)+0];  //第三个汉字  2*32 0 1
			green1 = green1<<8;
			green1 = green1 | String_DisCache_G[2*32+(i*2)+1];  //
			green1 = green1<<8;
			green1 = green1 | String_DisCache_G[3*32+(i*2)+0];   //第四个汉字  3*32  0  1
			green1 = green1<<8;
			green1 = green1 | String_DisCache_G[3*32+(i*2)+1];
			
			Green_Write[0]=green;
			Green_Write[1]=green1; 
      /************************************/
      blue=0;
			blue = blue | String_DisCache_B[(i*2)];    //正好下标0 1
			blue = blue <<8;
			blue = blue | String_DisCache_B[(i*2)+1];    //正好下标 2 3
			blue = blue<<8;
			blue = blue | String_DisCache_B[32+(i*2)+0];   //第二个汉字是从第下标32开始,所以32+0 1
			blue = blue<<8;
			blue = blue | String_DisCache_B[32+(i*2)+1];   //  2  3
      blue1=0;
			blue1 = blue1 | String_DisCache_B[2*32+(i*2)+0];  //第三个汉字  2*32 0 1
			blue1 = blue1<<8;
			blue1 = blue1 | String_DisCache_B[2*32+(i*2)+1];  //
			blue1 = blue1<<8;
			blue1 = blue1 | String_DisCache_B[3*32+(i*2)+0];   //第四个汉字  3*32  0  1
			blue1 = blue1<<8;
			blue1 = blue1 | String_DisCache_B[3*32+(i*2)+1];
			
			Blue_Write[0]=blue;
			Blue_Write[1]=blue1;
			RGB_Write(i);
		}
      LED_GREEN_OFF;
}


